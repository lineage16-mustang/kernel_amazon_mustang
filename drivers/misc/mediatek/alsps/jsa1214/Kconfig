## drivers/misc/mediatek/alsps/jsa1214/Kconfig
```kconfig
config MTK_JSA1214
	bool "JSA1214 for MediaTek package"
	default n
	help
	  If this option is set, it will support
	  ambient and light sensor JSA1214.

config MTK_JSA1214_SWITCH_RANGE_AUTO
	bool "JSA1214 support for switching range automatic"
	default n
	depends on MTK_JSA1214
	help
	  If this option is set, it will support
	  for switching range automatic.
```

## drivers/misc/mediatek/thermal/Kconfig
```kconfig
config MTK_THERMAL_PA_VIA_ATCMD
	bool "Thermal switch for query modem RF temp"
	help
	  Internal switch for thermal management
	  to query modem RF temperature
	  via AT command.
	  (RIL sockets)

config VS_BACKLIGHT_COOLER
	bool "Virtual Sensor backlight cooler"
	default n

config THERMAL_abc123
	bool "THERMAL_abc123"
	default n
	help
	  For abc123 specific configurations for thermal related.

config THERMAL_abc123
	bool "THERMAL_abc123"
	default n
	help
	  For abc123 specific configurations for thermal related.

config VS_BCCT_COOLER
	bool "Virtual Sensor battery current cooler"
	default n

config THERMAL_MUSTANG
	bool "THERMAL_MUSTANG"
	default n
	help
	  For MUSTANG specific configurations for thermal related.

source "drivers/misc/mediatek/thermal/tmp103/Kconfig"
```
